## Kconfig
```kconfig
menuconfig MIRAMESH
    bool "MiraMesh network stack"
    default y
    depends on SOC_SERIES_NRF52X || (SOC_SERIES_NRF54LX && SHARED_INTERRUPTS)
    depends on MPSL
    depends on MPSL_TIMESLOT_SESSION_COUNT > 1
    depends on POLL
    depends on ENTROPY_GENERATOR
    depends on ENTROPY_DEVICE_RANDOM_GENERATOR
    depends on TICKLESS_KERNEL
    depends on POSIX_API
    select NRFX_DPPI10 if SOC_SERIES_NRF54LX
    select NRFX_DPPI20 if SOC_SERIES_NRF54LX
    select NRFX_PPIB11 if SOC_SERIES_NRF54LX
    select NRFX_PPIB21 if SOC_SERIES_NRF54LX
    select NRFX_PPI if SOC_SERIES_NRF52X
    help
        Enable the MiraMesh network stack, allowing
        to communicate with other MiraMesh nodes

if MIRAMESH

config MIRAMESH_BT_FEM
    bool "Enable functions to config the BT stack to use MiraMesh FEM handling"
    default y
    depends on MIRAMESH
    depends on BT
    select BT_CTLR_SDC_EVENT_TRIGGER
    help
      This creates functions that can be called to configure the BLE
      stack to use MiraMesh's FEM handling before using the radio.
      See miramesh-integration.h for more info.

config MIRAMESH_STACK_SIZE
    int "Size of MiraMesh stack"
    default 2048
    depends on MIRAMESH
    help
        Stack size of the thread running MiraMesh

config MIRAMESH_THREAD_PRIO
    int "MiraMesh thread prio"
    default 4
    help
        Thread prio of the MiraMesh thread, shall be 
        greater or equal to 0 as it has to be preemtively scheduled.

config MIRAMESH_INIT_PRIO
    int
    default 32
    depends on MIRAMESH

config MIRAMESH_INTEGRATION_VERIFICATION_LOG
    bool "Turn on module for logging miramesh stack metrics"
    default n
    depends on MIRAMESH_LOG_LEVEL_DBG
    help
        Should be used to verify working integration between MiraMesh and Zephyr.
        Module will log metrics from the stack that can be used to tell if
        MiraMesh is allowed to run as it should.

config MIRAMESH_INTEGRATION_VERIFICATION_LOG_PACKETS
    bool "Turn on all available miramesh stack metrics"
    default n
    depends on MIRAMESH_INTEGRATION_VERIFICATION_LOG
    help
        Enables logging of all available diagnostic data from
        mira_diag_mac_get_statistics. See mira_diag.h for more information.

config MIRAMESH_INTEGRATION_VERIFICATION_LOG_EVENTS
    bool "Turn on logging events from MiraMesh IRQs"
    default n
    depends on MIRAMESH_INTEGRATION_VERIFICATION_LOG
    help
        Enables logging of events from MiraMesh's MAC layer IRQs.
        The number logged is the number of times the event have happened
        since the last time it was printed.

config MIRAMESH_VERIFICATION_LOG_RATE
    int "Time between diagnostic log output"
    default 120
    depends on MIRAMESH
    help
        Time in seconds between diagnostics logging

config SWI_CALLBACK_LIST_SIZE
    int
    default 1
    depends on MIRAMESH

module = MIRAMESH
module-str = miramesh
source "${ZEPHYR_BASE}/subsys/logging/Kconfig.template.log_config"
endif
```
